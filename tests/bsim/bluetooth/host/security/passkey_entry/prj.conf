## CMakeLists.txt
```
# Copyright (c) 2026 Silicon Laboratories Inc.
# SPDX-License-Identifier: Apache-2.0

cmake_minimum_required(VERSION 3.20.0)
find_package(Zephyr REQUIRED HINTS $ENV{ZEPHYR_BASE})
project(bsim_test_passkey_entry)

target_sources(app PRIVATE src/main.c src/crypto.c)

add_subdirectory(${ZEPHYR_BASE}/tests/bsim/babblekit babblekit)
target_link_libraries(app PRIVATE babblekit)

zephyr_include_directories(
  ${BSIM_COMPONENTS_PATH}/libUtilv1/src/
  ${BSIM_COMPONENTS_PATH}/libPhyComv1/src/
)

target_include_directories(app PRIVATE ${ZEPHYR_BASE}/subsys/bluetooth)
```

## prj.conf
```kconfig
CONFIG_BT=y
CONFIG_BT_CENTRAL=y
CONFIG_BT_PERIPHERAL=y
CONFIG_BT_SMP=y
CONFIG_BT_SMP_SC_PAIR_ONLY=y
CONFIG_BT_DEVICE_NAME="spake_rfc9382_n"
CONFIG_LOG=y
CONFIG_ASSERT=y

CONFIG_BT_MAX_CONN=1
CONFIG_MBEDTLS_PSA_P256M_DRIVER_ENABLED=n
CONFIG_BT_LONG_WQ_STACK_SIZE=8192
CONFIG_MAIN_STACK_SIZE=8192
CONFIG_MBEDTLS_HEAP_SIZE=32768
CONFIG_MBEDTLS_ENABLE_HEAP=y
CONFIG_BT_TESTING=y
CONFIG_BT_GATT_CLIENT=y
```

## src/main.c
```c
/* SPDX-License-Identifier: Apache-2.0 */
#include <string.h>
#include <zephyr/bluetooth/bluetooth.h>
#include <zephyr/bluetooth/conn.h>
#include <zephyr/bluetooth/gatt.h>
#include <zephyr/kernel.h>
#include "babblekit/testcase.h"
#include "babblekit/sync.h"
#include "host/smp.h"

void test_spake_crypto(void);

static const struct scenario {
	const char *name;
	uint32_t a, b;
	uint16_t delay_a, delay_b;
	enum bt_spake_test_fault fault;
	enum bt_security_err error;
} cases[] = {
	{"matching", 123456, 123456, 0, 0, BT_SPAKE_TEST_NONE, BT_SECURITY_ERR_SUCCESS},
	{"mismatch", 123456, 123457, 0, 0, BT_SPAKE_TEST_NONE, BT_SECURITY_ERR_AUTH_FAIL},
	{"recovery", 123456, 123456, 0, 0, BT_SPAKE_TEST_NONE, BT_SECURITY_ERR_SUCCESS},
	{"delayed-B", 123456, 123456, 0, 300, BT_SPAKE_TEST_NONE, BT_SECURITY_ERR_SUCCESS},
	{"delayed-A", 123456, 123456, 300, 0, BT_SPAKE_TEST_NONE, BT_SECURITY_ERR_SUCCESS},
	{"zero", 0, 0, 0, 0, BT_SPAKE_TEST_NONE, BT_SECURITY_ERR_SUCCESS},
	{"invalid-point", 123456, 123456, 0, 0, BT_SPAKE_TEST_INVALID_POINT,
	 BT_SECURITY_ERR_INVALID_PARAM},
	{"duplicate-point", 123456, 123456, 0, 0, BT_SPAKE_TEST_DUPLICATE_POINT,
	 BT_SECURITY_ERR_UNSPECIFIED},
};

static struct bt_conn *connection;
static bool is_central, complete, failed;
static bt_security_t reached_level;
static enum bt_security_err failure_reason;
static size_t scenario_index;
static int64_t pairing_start_ms, pairing_elapsed_ms;
static atomic_t keypress_received;
static uint16_t value_handle;
static uint8_t payload[8], stored[8];
static size_t stored_len;
static K_SEM_DEFINE(connected_sem, 0, 1);
static K_SEM_DEFINE(disconnected_sem, 0, 1);
static K_SEM_DEFINE(pair_sem, 0, 1);
static K_SEM_DEFINE(encrypted_sem, 0, 1);
static K_SEM_DEFINE(io_sem, 0, 1);
static K_SEM_DEFINE(written_sem, 0, 1);

static void wait_event(struct k_sem *sem, const char *name)
{
	TEST_ASSERT(k_sem_take(sem, K_SECONDS(10)) == 0, "%s: timed out waiting for %s",
		    cases[scenario_index].name, name);
}

static void barrier(void)
{
	bk_sync_send();
	bk_sync_wait();
}

static ssize_t read_value(struct bt_conn *conn, const struct bt_gatt_attr *attr,
			 void *buf, uint16_t len, uint16_t offset)
{
	return bt_gatt_attr_read(conn, attr, buf, len, offset, stored, stored_len);
}

static ssize_t write_value(struct bt_conn *conn, const struct bt_gatt_attr *attr,
			  const void *buf, uint16_t len, uint16_t offset, uint8_t flags)
{
	ARG_UNUSED(attr);
	ARG_UNUSED(flags);
	TEST_ASSERT(bt_conn_get_security(conn) == BT_SECURITY_L4, "Unencrypted GATT write");
	if (offset || len != sizeof(stored)) {
		return BT_GATT_ERR(BT_ATT_ERR_INVALID_ATTRIBUTE_LEN);
	}
	memcpy(stored, buf, len);
	stored_len = len;
	k_sem_give(&written_sem);
	return len;
}

#define SERVICE_UUID BT_UUID_DECLARE_128(BT_UUID_128_ENCODE(0xf0b10000, 0x7341, 0x4528, \
							  0x9ab1, 0x010203040506))
#define VALUE_UUID BT_UUID_DECLARE_128(BT_UUID_128_ENCODE(0xf0b10001, 0x7341, 0x4528, \
							0x9ab1, 0x010203040506))

BT_GATT_SERVICE_DEFINE(test_service,
	BT_GATT_PRIMARY_SERVICE(SERVICE_UUID),
	BT_GATT_CHARACTERISTIC(VALUE_UUID, BT_GATT_CHRC_READ | BT_GATT_CHRC_WRITE,
		BT_GATT_PERM_READ_ENCRYPT | BT_GATT_PERM_WRITE_ENCRYPT,
		read_value, write_value, NULL));

static void connected(struct bt_conn *conn, uint8_t err)
{
	TEST_ASSERT(err == 0, "Connection failed (%u)", err);
	connection = bt_conn_ref(conn);
	k_sem_give(&connected_sem);
}

static void disconnected(struct bt_conn *conn, uint8_t reason)
{
	ARG_UNUSED(conn);
	ARG_UNUSED(reason);
	bt_conn_drop(&connection);
	k_sem_give(&disconnected_sem);
}

static void security_changed(struct bt_conn *conn, bt_security_t level, enum bt_security_err err)
{
	ARG_UNUSED(conn);
	if (err == BT_SECURITY_ERR_SUCCESS) {
		reached_level = level;
		if (level == BT_SECURITY_L4) {
			if (is_central) {
				pairing_elapsed_ms =
					k_uptime_get() - pairing_start_ms;
			}
			TEST_ASSERT(cases[scenario_index].error == BT_SECURITY_ERR_SUCCESS,
				    "Negative case reached L4");
			k_sem_give(&encrypted_sem);
		}
	}
}

BT_CONN_CB_DEFINE(conn_cb) = {
	.connected = connected,
	.disconnected = disconnected,
	.security_changed = security_changed,
};

static void enter_password(struct k_work *work)
{
	const struct scenario *s = &cases[scenario_index];
	uint32_t password = is_central ? s->a : s->b;

	ARG_UNUSED(work);

	TEST_ASSERT(connection != NULL, "Passkey callback after disconnect");
	TEST_ASSERT(bt_conn_auth_passkey_entry(connection, password) == 0, "Passkey entry failed");
}

static K_WORK_DELAYABLE_DEFINE(passkey_work, enter_password);

static void passkey_entry(struct bt_conn *conn)
{
	const struct scenario *s = &cases[scenario_index];
	uint16_t delay = is_central ? s->delay_a : s->delay_b;

	ARG_UNUSED(conn);
	if (IS_ENABLED(CONFIG_BT_PASSKEY_KEYPRESS) && scenario_index == 0) {
		TEST_ASSERT(bt_conn_auth_keypress_notify(connection,
				BT_CONN_AUTH_KEYPRESS_ENTRY_STARTED) == 0, "Keypress send failed");
	}
	if (delay) {
		k_work_schedule(&passkey_work, K_MSEC(delay));
	} else {
		enter_password(NULL);
	}
}

static void auth_cancel(struct bt_conn *conn)
{
	ARG_UNUSED(conn);
	TEST_ASSERT(cases[scenario_index].error != BT_SECURITY_ERR_SUCCESS,
		    "Unexpected authentication cancellation");
}

#if defined(CONFIG_BT_PASSKEY_KEYPRESS)
static void keypress_notify(struct bt_conn *conn, enum bt_conn_auth_keypress type)
{
	ARG_UNUSED(conn);
	TEST_ASSERT(scenario_index == 0 && type == BT_CONN_AUTH_KEYPRESS_ENTRY_STARTED,
		    "Unexpected keypress notification");
	atomic_inc(&keypress_received);
}
#endif

static struct bt_conn_auth_cb auth_cb = {
	.passkey_entry = passkey_entry,
	.cancel = auth_cancel,
#if defined(CONFIG_BT_PASSKEY_KEYPRESS)
	.passkey_display_keypress = keypress_notify,
#endif
};

static void pairing_complete(struct bt_conn *conn, bool bonded)
{
	ARG_UNUSED(conn);
	ARG_UNUSED(bonded);
	TEST_ASSERT(cases[scenario_index].error == BT_SECURITY_ERR_SUCCESS,
		    "Negative case reported pairing complete");
	complete = true;
	k_sem_give(&pair_sem);
}

static void pairing_failed(struct bt_conn *conn, enum bt_security_err reason)
{
	ARG_UNUSED(conn);
	if (is_central) {
		pairing_elapsed_ms =
			k_uptime_get() - pairing_start_ms;
	}
	failed = true;
	failure_reason = reason;
	k_sem_give(&pair_sem);
}

static struct bt_conn_auth_info_cb info_cb = {
	.pairing_complete = pairing_complete,
	.pairing_failed = pairing_failed,
};

static void device_found(const bt_addr_le_t *addr, int8_t rssi, uint8_t type,
			 struct net_buf_simple *ad)
{
	struct bt_conn *pending = NULL;

	ARG_UNUSED(ad);
	if (type != BT_GAP_ADV_TYPE_ADV_IND || rssi < -70 || bt_le_scan_stop()) {
		return;
	}
	TEST_ASSERT(bt_conn_le_create(addr, BT_CONN_LE_CREATE_CONN, BT_LE_CONN_PARAM_DEFAULT,
				      &pending) == 0, "Create connection failed");
	bt_conn_unref(pending);
}

static uint8_t discovered(struct bt_conn *conn, const struct bt_gatt_attr *attr,
			  struct bt_gatt_discover_params *params)
{
	ARG_UNUSED(conn);
	ARG_UNUSED(params);
	TEST_ASSERT(attr != NULL, "Test characteristic not found");
	value_handle = ((struct bt_gatt_chrc *)attr->user_data)->value_handle;
	k_sem_give(&io_sem);
	return BT_GATT_ITER_STOP;
}

static void wrote(struct bt_conn *conn, uint8_t err, struct bt_gatt_write_params *params)
{
	ARG_UNUSED(conn);
	ARG_UNUSED(params);
	TEST_ASSERT(err == 0, "Encrypted write failed (%u)", err);
	k_sem_give(&io_sem);
}

static uint8_t read_back(struct bt_conn *conn, uint8_t err, struct bt_gatt_read_params *params,
			 const void *data, uint16_t len)
{
	ARG_UNUSED(conn);
	ARG_UNUSED(params);
	TEST_ASSERT(err == 0 && data && len == sizeof(payload), "Encrypted read failed");
	TEST_ASSERT(memcmp(data, payload, len) == 0, "Encrypted echo differs");
	k_sem_give(&io_sem);
	return BT_GATT_ITER_STOP;
}

static void encrypted_echo(void)
{
	struct bt_gatt_discover_params discover = {
		.uuid = VALUE_UUID, .func = discovered, .start_handle = 1,
		.end_handle = 0xffff, .type = BT_GATT_DISCOVER_CHARACTERISTIC,
	};
	struct bt_gatt_write_params write = {.func = wrote, .data = payload,
		.length = sizeof(payload)};
	struct bt_gatt_read_params read = {.func = read_back, .handle_count = 1};

	for (int i = 0; i < sizeof(payload); i++) {
		payload[i] = 0xa0 + i + scenario_index;
	}
	TEST_ASSERT(bt_gatt_discover(connection, &discover) == 0, "Discover failed");
	wait_event(&io_sem, "discovery");
	write.handle = value_handle;
	TEST_ASSERT(bt_gatt_write(connection, &write) == 0, "Write start failed");
	wait_event(&io_sem, "write response");
	read.single.handle = value_handle;
	TEST_ASSERT(bt_gatt_read(connection, &read) == 0, "Read start failed");
	wait_event(&io_sem, "read response");
	printk("SPAKE encrypted GATT echo verified: 8 bytes written and read back\n");
}

static void run(bool central)
{
	TEST_START("SPAKE RFC9382-N regression");
	is_central = central;
	TEST_ASSERT(bk_sync_init() == 0, "Sync init failed");
	TEST_ASSERT(bt_enable(NULL) == 0, "Bluetooth init failed");
	bt_set_bondable(false);
	TEST_ASSERT(bt_conn_auth_cb_register(&auth_cb) == 0, "Auth register failed");
	TEST_ASSERT(bt_conn_auth_info_cb_register(&info_cb) == 0, "Info register failed");
	if (central) {
		test_spake_crypto();
	}
	barrier();
	for (scenario_index = 0; scenario_index < ARRAY_SIZE(cases); scenario_index++) {
		const struct scenario *s = &cases[scenario_index];
		int64_t start = k_uptime_get();

		complete = failed = false;
		atomic_clear(&keypress_received);
		reached_level = BT_SECURITY_L1;
		failure_reason = BT_SECURITY_ERR_SUCCESS;
		pairing_elapsed_ms = -1;
		stored_len = 0;
		k_sem_reset(&pair_sem);
		k_sem_reset(&encrypted_sem);
		k_sem_reset(&io_sem);
		k_sem_reset(&written_sem);
		bt_smp_spake_test_fault(central ? s->fault : BT_SPAKE_TEST_NONE);
		barrier();
		if (central) {
			TEST_ASSERT(bt_le_scan_start(BT_LE_SCAN_ACTIVE, device_found) == 0,
				    "Scan failed");
		} else {
			TEST_ASSERT(bt_le_adv_start(BT_LE_ADV_CONN_FAST_1, NULL, 0, NULL, 0) == 0,
				    "Advertising failed");
		}
		wait_event(&connected_sem, "connection");
		if (central) {
			pairing_start_ms = k_uptime_get();
			TEST_ASSERT(bt_conn_set_security(connection, BT_SECURITY_L4) == 0,
				    "Security request failed");
		}
		wait_event(&pair_sem, "pairing result");
		if (s->error == BT_SECURITY_ERR_SUCCESS) {
			TEST_ASSERT(complete && !failed, "%s failed (%d)", s->name, failure_reason);
			wait_event(&encrypted_sem, "encryption");
			TEST_ASSERT(reached_level == BT_SECURITY_L4, "Expected L4");
			if (central) {
				encrypted_echo();
			} else {
				wait_event(&written_sem, "encrypted write");
			}
		} else {
			TEST_ASSERT(failed && !complete && reached_level < BT_SECURITY_L4,
				    "Expected explicit rejection");
			TEST_ASSERT(failure_reason == s->error, "%s: reason %d, expected %d",
				    s->name, failure_reason, s->error);
		}
		barrier();
		if (IS_ENABLED(CONFIG_BT_PASSKEY_KEYPRESS) && scenario_index == 0) {
			TEST_ASSERT(atomic_get(&keypress_received) == 1,
				    "Keypress was not delivered");
			printk("SPAKE keypress notification received role=%s\n",
			       central ? "A" : "B");
		}
		printk("SPAKE CASE %s PASS role=%s elapsed_ms=%lld "
		       "pairing_ms=%lld reason=%d\n", s->name, central ? "A" : "B",
		       (long long)(k_uptime_get() - start),
		       (long long)pairing_elapsed_ms, failure_reason);
		if (central) {
			TEST_ASSERT(bt_conn_disconnect(connection, BT_HCI_ERR_REMOTE_USER_TERM_CONN)
				    == 0, "Disconnect failed");
		}
		wait_event(&disconnected_sem, "disconnect");
		(void)k_work_cancel_delayable(&passkey_work);
		TEST_ASSERT(bt_unpair(BT_ID_DEFAULT, BT_ADDR_LE_ANY) == 0, "Unpair failed");
		/* Let connection recycling and any invalidated crypto job finish. */
		k_sleep(K_MSEC(100));
		barrier();
	}
	TEST_PASS("All SPAKE RFC9382-N scenarios passed");
}

static void central(void) { run(true); }
static void peripheral(void) { run(false); }

static const struct bst_test_instance instances[] = {
	{.test_id = "central", .test_main_f = central},
	{.test_id = "peripheral", .test_main_f = peripheral},
	BSTEST_END_MARKER,
};

static struct bst_test_list *install(struct bst_test_list *tests)
{
	return bst_add_tests(tests, instances);
}

bst_test_install_t test_installers[] = {install, NULL};

int main(void)
{
	bst_main();
	return 0;
}
```

## src/crypto.c
```c
/* SPDX-License-Identifier: Apache-2.0 */
#include <string.h>
#include <zephyr/sys/byteorder.h>
#include <zephyr/sys/util.h>
#include <zephyr/sys/printk.h>
#include "babblekit/testcase.h"
#include "crypto/bt_crypto.h"
#include "crypto/bt_spake.h"
#include "vectors.h"

void test_spake_crypto(void)
{
	struct bt_spake_context a = {.central = true, .password = 123456};
	struct bt_spake_context b = {.central = false, .password = 123456};
	struct bt_spake_transcript t;
	bt_addr_le_t aa = {0}, bb = {0};
	uint8_t scalar[32] = {0}, point[64], ka[32], kb[32];
	uint8_t f5_input[32], mackey[16], ltk[16], ea[16], eb[16];
	uint8_t r[16] = {0};

	for (int i = 0; i < 7; i++) {
		t.a[i] = i;
		t.b[i] = i + 7;
		t.preq[i] = i + 14;
		t.prsp[i] = i + 21;
	}
	for (int i = 0; i < 16; i++) {
		t.na[i] = i;
		t.nb[i] = i + 16;
	}
	memcpy(t.pka, vector_pka, 64);
	memcpy(t.pkb, vector_pkb, 64);
	scalar[31] = 5;
	TEST_ASSERT(bt_spake_point_mul(scalar, vector_pkb, point) == 0, "Full DH failed");
	TEST_ASSERT(memcmp(point, vector_m, 64) == 0, "Full DH differs from oracle");
	memcpy(a.m, point, 64);
	memcpy(b.m, point, 64);
	a.secret[31] = 2;
	b.secret[31] = 3;
	TEST_ASSERT(bt_spake_mask(&a) == 0 && bt_spake_mask(&b) == 0, "Mask failed");
	TEST_ASSERT(memcmp(a.local, vector_xstar, 64) == 0, "X* differs from oracle");
	TEST_ASSERT(memcmp(b.local, vector_ystar, 64) == 0, "Y* differs from oracle");
	memcpy(a.peer, b.local, 64);
	memcpy(b.peer, a.local, 64);
	TEST_ASSERT(bt_spake_shared(&a) == 0 && bt_spake_shared(&b) == 0, "Unmask failed");
	TEST_ASSERT(memcmp(a.shared, vector_shared, 64) == 0, "ZA differs from oracle");
	TEST_ASSERT(memcmp(b.shared, vector_shared, 64) == 0, "ZB differs from oracle");
	TEST_ASSERT(bt_spake_derive(&a, &t, ka) == 0 && bt_spake_derive(&b, &t, kb) == 0,
		    "KDF failed");
	TEST_ASSERT(memcmp(ka, vector_key, 32) == 0 && memcmp(kb, vector_key, 32) == 0,
		    "KDF differs from independent SHA256 oracle");
	aa.type = t.a[0];
	bb.type = t.b[0];
	memcpy(aa.a.val, t.a + 1, 6);
	memcpy(bb.a.val, t.b + 1, 6);
	sys_memcpy_swap(f5_input, ka, sizeof(f5_input));
	TEST_ASSERT(bt_crypto_f5(f5_input, t.na, t.nb, &aa, &bb, mackey, ltk) == 0,
		    "f5 failed");
	TEST_ASSERT(memcmp(mackey, vector_mackey, 16) == 0 &&
		    memcmp(ltk, vector_ltk, 16) == 0, "f5 differs from independent oracle");
	sys_put_le32(a.password, r);
	TEST_ASSERT(bt_crypto_f6(mackey, t.na, t.nb, r, t.preq + 1, &aa, &bb, ea) == 0,
		    "central f6 failed");
	TEST_ASSERT(bt_crypto_f6(mackey, t.nb, t.na, r, t.prsp + 1, &bb, &aa, eb) == 0,
		    "peripheral f6 failed");
	TEST_ASSERT(memcmp(ea, vector_ea, 16) == 0 && memcmp(eb, vector_eb, 16) == 0,
		    "f6 differs from independent oracle");
	t.preq[0] ^= 1;
	TEST_ASSERT(bt_spake_derive(&a, &t, kb) == 0 && memcmp(ka, kb, 32) != 0,
		    "Transcript not bound");

	/* Zero password must work; it is not a valid scalar for ecp_mul itself. */
	a.password = b.password = 0;
	TEST_ASSERT(bt_spake_mask(&a) == 0 && bt_spake_mask(&b) == 0, "Zero mask failed");
	memcpy(a.peer, b.local, 64);
	memcpy(b.peer, a.local, 64);
	TEST_ASSERT(bt_spake_shared(&a) == 0 && bt_spake_shared(&b) == 0, "Zero unmask");
	TEST_ASSERT(memcmp(a.shared, vector_shared, 64) == 0 &&
		    memcmp(b.shared, vector_shared, 64) == 0, "Zero shared differs");

	/* Upper passkey boundary: both roles must agree on the same xyG and K. */
	a.password = b.password = 999999;
	TEST_ASSERT(bt_spake_mask(&a) == 0 && bt_spake_mask(&b) == 0, "Max mask failed");
	memcpy(a.peer, b.local, 64);
	memcpy(b.peer, a.local, 64);
	TEST_ASSERT(bt_spake_shared(&a) == 0 && bt_spake_shared(&b) == 0, "Max unmask");
	TEST_ASSERT(memcmp(a.shared, vector_shared, 64) == 0 &&
		    memcmp(b.shared, vector_shared, 64) == 0, "Max shared differs");
	TEST_ASSERT(bt_spake_derive(&a, &t, ka) == 0 && bt_spake_derive(&b, &t, kb) == 0,
		    "Max KDF failed");
	TEST_ASSERT(memcmp(ka, kb, 32) == 0, "Max passwords produced different keys");

	a.password = 123456;
	b.password = 123457;
	TEST_ASSERT(bt_spake_mask(&a) == 0 && bt_spake_mask(&b) == 0, "Mismatch mask");
	memcpy(a.peer, b.local, 64);
	memcpy(b.peer, a.local, 64);
	TEST_ASSERT(bt_spake_shared(&a) == 0 && bt_spake_shared(&b) == 0, "Mismatch shared");
	TEST_ASSERT(bt_spake_derive(&a, &t, ka) == 0 && bt_spake_derive(&b, &t, kb) == 0,
		    "Mismatch KDF");
	TEST_ASSERT(memcmp(ka, kb, 32) != 0, "Different passwords produced same key");
	memset(a.peer, 0, 64);
	TEST_ASSERT(bt_spake_shared(&a) != 0, "Invalid point accepted");
	bt_spake_clear(&a);
	bt_spake_clear(&b);
	TEST_ASSERT(memcmp(&a, &b, sizeof(a)) == 0, "Context cleanup failed");
	printk("SPAKE crypto: point, KDF, f5/f6, boundaries and invalid point passed\n");
}
```

## src/vectors.h
```c
/* SPDX-License-Identifier: Apache-2.0 */
/* Reproduce with: python3 tools/reference_vectors.py */

static const uint8_t vector_pka[64] = {
	0x51, 0x59, 0x0b, 0x7a, 0x51, 0x51, 0x40, 0xd2,
	0xd7, 0x84, 0xc8, 0x56, 0x08, 0x66, 0x8f, 0xdf,
	0xef, 0x8c, 0x82, 0xfd, 0x1f, 0x5b, 0xe5, 0x24,
	0x21, 0x55, 0x4a, 0x0d, 0xc3, 0xd0, 0x33, 0xed,
	0xe0, 0xc1, 0x7d, 0xa8, 0x90, 0x4a, 0x72, 0x7d,
	0x8a, 0xe1, 0xbf, 0x36, 0xbf, 0x8a, 0x79, 0x26,
	0x0d, 0x01, 0x2f, 0x00, 0xd4, 0xd8, 0x08, 0x88,
	0xd1, 0xd0, 0xbb, 0x44, 0xfd, 0xa1, 0x6d, 0xa4,
};

static const uint8_t vector_pkb[64] = {
	0x8e, 0x53, 0x3b, 0x6f, 0xa0, 0xbf, 0x7b, 0x46,
	0x25, 0xbb, 0x30, 0x66, 0x7c, 0x01, 0xfb, 0x60,
	0x7e, 0xf9, 0xf8, 0xb8, 0xa8, 0x0f, 0xef, 0x5b,
	0x30, 0x06, 0x28, 0x70, 0x31, 0x87, 0xb2, 0xa3,
	0x73, 0xeb, 0x1d, 0xbd, 0xe0, 0x33, 0x18, 0x36,
	0x6d, 0x06, 0x9f, 0x83, 0xa6, 0xf5, 0x90, 0x00,
	0x53, 0xc7, 0x36, 0x33, 0xcb, 0x04, 0x1b, 0x21,
	0xc5, 0x5e, 0x1a, 0x86, 0xc1, 0xf4, 0x00, 0xb4,
};

static const uint8_t vector_m[64] = {
	0xd5, 0x8d, 0x4a, 0x58, 0x9e, 0xd2, 0x7d, 0x16,
	0x8f, 0xfa, 0x3a, 0xd7, 0x32, 0x6c, 0x48, 0xca,
	0x94, 0xe8, 0xe1, 0xfe, 0x92, 0xaf, 0x97, 0x00,
	0xa1, 0x2d, 0x38, 0x90, 0x33, 0xbb, 0x29, 0x1a,
	0xd4, 0x55, 0x14, 0xd1, 0x02, 0x72, 0x6b, 0x85,
	0x76, 0xea, 0x92, 0x63, 0x2d, 0xc7, 0xfe, 0xf6,
	0x67, 0x27, 0x1c, 0x16, 0x3b, 0x03, 0x49, 0x79,
	0xa5, 0xb0, 0xc9, 0xc6, 0xf5, 0x86, 0xb9, 0xd5,
};

static const uint8_t vector_n[64] = {
	0xd8, 0xbb, 0xd6, 0xc6, 0x39, 0xc6, 0x29, 0x37,
	0xb0, 0x4d, 0x99, 0x7f, 0x38, 0xc3, 0x77, 0x07,
	0x19, 0xc6, 0x29, 0xd7, 0x01, 0x4d, 0x49, 0xa2,
	0x4b, 0x4f, 0x98, 0xba, 0xa1, 0x29, 0x2b, 0x49,
	0x07, 0xd6, 0x0a, 0xa6, 0xbf, 0xad, 0xe4, 0x50,
	0x08, 0xa6, 0x36, 0x33, 0x7f, 0x51, 0x68, 0xc6,
	0x4d, 0x9b, 0xd3, 0x60, 0x34, 0x80, 0x8c, 0xd5,
	0x64, 0x49, 0x0b, 0x1e, 0x65, 0x6e, 0xdb, 0xe7,
};

static const uint8_t vector_xstar[64] = {
	0xf4, 0x61, 0x74, 0x1a, 0x00, 0x31, 0x4f, 0xe4,
	0xd7, 0x71, 0x2c, 0x98, 0x56, 0x0a, 0x0e, 0x7a,
	0x1c, 0xfb, 0x08, 0x95, 0xad, 0xd0, 0x2c, 0x94,
	0x0b, 0x59, 0x3b, 0x70, 0x63, 0x49, 0x44, 0xc9,
	0x90, 0x20, 0xfc, 0x82, 0x52, 0xc3, 0x54, 0x82,
	0xf1, 0x96, 0x2c, 0x71, 0xd3, 0xaf, 0x06, 0x76,
	0x65, 0x34, 0xdd, 0xad, 0xec, 0x35, 0x18, 0x69,
	0x4e, 0x68, 0xb8, 0xbc, 0xbc, 0x9c, 0xaa, 0x50,
};

static const uint8_t vector_ystar[64] = {
	0x20, 0x03, 0x9a, 0x4e, 0x72, 0xfc, 0x5f, 0x96,
	0x69, 0x46, 0xed, 0xcc, 0x34, 0xa1, 0x0f, 0xda,
	0xfc, 0x3a, 0xe1, 0x06, 0x55, 0x3f, 0xd6, 0xcc,
	0x44, 0x7f, 0xa6, 0xb1, 0xd8, 0x2c, 0x79, 0x2e,
	0x65, 0x0c, 0xa4, 0x5f, 0xdb, 0x71, 0x08, 0x7b,
	0x54, 0x01, 0x8f, 0xfc, 0x91, 0xb2, 0x4f, 0x71,
	0xd1, 0xca, 0xd4, 0xc9, 0x67, 0xd6, 0x22, 0xac,
	0xa2, 0xf5, 0xd4, 0x49, 0x0b, 0x70, 0x08, 0x13,
};

static const uint8_t vector_shared[64] = {
	0xb0, 0x1a, 0x17, 0x2a, 0x76, 0xa4, 0x60, 0x2c,
	0x92, 0xd3, 0x24, 0x2c, 0xb8, 0x97, 0xdd, 0xe3,
	0x02, 0x4c, 0x74, 0x0d, 0xeb, 0xb2, 0x15, 0xb4,
	0xc6, 0xb0, 0xaa, 0xe9, 0x3c, 0x22, 0x91, 0xa9,
	0xe8, 0x5c, 0x10, 0x74, 0x32, 0x37, 0xda, 0xd5,
	0x6f, 0xec, 0x0e, 0x2d, 0xfb, 0xa7, 0x03, 0x79,
	0x1c, 0x00, 0xf7, 0x70, 0x1c, 0x7e, 0x16, 0xbd,
	0xfd, 0x7c, 0x48, 0x53, 0x8f, 0xc7, 0x7f, 0xe2,
};

static const uint8_t vector_key[32] = {
	0xb6, 0x93, 0x8d, 0x5e, 0xee, 0xe5, 0x94, 0xb3,
	0xb4, 0xc6, 0xa3, 0x3b, 0xd2, 0x49, 0x3a, 0xec,
	0xa9, 0x0b, 0x71, 0x86, 0x62, 0x78, 0xc3, 0x65,
	0x3c, 0x04, 0x61, 0x5a, 0xda, 0x8b, 0x12, 0x09,
};

static const uint8_t vector_mackey[16] = {
	0x45, 0x91, 0x9a, 0x70, 0x0a, 0x9f, 0xfe, 0xf4,
	0xf5, 0x3b, 0x5b, 0x8d, 0xdc, 0x7b, 0x68, 0x96,
};

static const uint8_t vector_ltk[16] = {
	0xa5, 0x68, 0x96, 0xc7, 0x84, 0x4a, 0xf7, 0xef,
	0x9c, 0xf3, 0xd6, 0x47, 0xf6, 0xe2, 0xcd, 0x6c,
};

static const uint8_t vector_ea[16] = {
	0xc3, 0xf1, 0xbf, 0xb6, 0xf4, 0x22, 0x66, 0xf7,
	0xac, 0xfe, 0xfc, 0xb3, 0x8f, 0xf9, 0xc8, 0x02,
};

static const uint8_t vector_eb[16] = {
	0xee, 0xc3, 0xf4, 0x03, 0x0c, 0x2e, 0x2a, 0x99,
	0x1a, 0x60, 0x05, 0x0b, 0x0a, 0x40, 0xa9, 0xd6,
};
```
